## CMakeLists.txt
```
# SPDX-License-Identifier: Apache-2.0

#
# ------------------------------------------------------------------
#  Request Full Access to Author: Faizan Saleem Siddiqui
#  Email: faizansaleemsdq@yahoo.com
#  (11 lines of this file are hidden by the author)
# ------------------------------------------------------------------
#
	src/ble_shell.c
)
```

## sample.yaml
```
sample:
  description: ROHM RPR-0720 proximity sensor on nRF52840 (Zephyr)
#
# ------------------------------------------------------------------
#  Request Full Access to Author: Faizan Saleem Siddiqui
#  Email: faizansaleemsdq@yahoo.com
#  (4 lines of this file are hidden by the author)
# ------------------------------------------------------------------
#
      - nrf52840dk/nrf52840
    tags: sensor
```

## prj.conf
```kconfig
# ---------------- I2C / GPIO ----------------
CONFIG_I2C=y
#
# ------------------------------------------------------------------
#  Request Full Access to Author: Faizan Saleem Siddiqui
#  Email: faizansaleemsdq@yahoo.com
#  (61 lines of this file are hidden by the author)
# ------------------------------------------------------------------
#

CONFIG_MAIN_STACK_SIZE=2048
```

## boards/nrf52840dk_nrf52840.overlay
```dts
/*
 * RPR-0720 on I2C0 (TWIM0)
//
// ------------------------------------------------------------------
//  Request Full Access to Author: Faizan Saleem Siddiqui
//  Email: faizansaleemsdq@yahoo.com
//  (82 lines of this file are hidden by the author)
// ------------------------------------------------------------------
//
	};
};
```

## dts/bindings/rohm,rpr0720.yaml
```yaml
description: ROHM RPR-0720 VCSEL proximity sensor

#
# ------------------------------------------------------------------
#  Request Full Access to Author: Faizan Saleem Siddiqui
#  Email: faizansaleemsdq@yahoo.com
#  (1 lines of this file are hidden by the author)
# ------------------------------------------------------------------
#

include: i2c-device.yaml
```

## src/main.c
```c
/*
 * RPR-0720 proximity sensor firmware for nRF52840 (Zephyr RTOS)
//
// ------------------------------------------------------------------
//  Request Full Access to Author: Faizan Saleem Siddiqui
//  Email: faizansaleemsdq@yahoo.com
//  (258 lines of this file are hidden by the author)
// ------------------------------------------------------------------
//
	return 0;
}
```

## src/ble_shell.c
```c
/*
 * BLE serial link implemented as a Zephyr shell transport.
//
// ------------------------------------------------------------------
//  Request Full Access to Author: Faizan Saleem Siddiqui
//  Email: faizansaleemsdq@yahoo.com
//  (309 lines of this file are hidden by the author)
// ------------------------------------------------------------------
//
	return 0;
}
```

## src/ble_shell.h
```c
#pragma once

//
// ------------------------------------------------------------------
//  Request Full Access to Author: Faizan Saleem Siddiqui
//  Email: faizansaleemsdq@yahoo.com
//  (22 lines of this file are hidden by the author)
// ------------------------------------------------------------------
//
/* Enables Bluetooth, starts advertising and attaches the BLE shell. */
int ble_shell_init(void);
```

## src/calibration.c
```c
#include "calibration.h"
#include "rpr0720.h"
//
// ------------------------------------------------------------------
//  Request Full Access to Author: Faizan Saleem Siddiqui
//  Email: faizansaleemsdq@yahoo.com
//  (98 lines of this file are hidden by the author)
// ------------------------------------------------------------------
//
	return result;
}
```

## src/calibration.h
```c
#pragma once

//
// ------------------------------------------------------------------
//  Request Full Access to Author: Faizan Saleem Siddiqui
//  Email: faizansaleemsdq@yahoo.com
//  (15 lines of this file are hidden by the author)
// ------------------------------------------------------------------
//
/* Piecewise linear interpolation; NAN if uncalibrated or out of range. */
float calibration_calculate_distance(uint16_t count);
```

## src/commands.c
```c
/*
 * Serial command processing (replacement for processCommand()).
//
// ------------------------------------------------------------------
//  Request Full Access to Author: Faizan Saleem Siddiqui
//  Email: faizansaleemsdq@yahoo.com
//  (239 lines of this file are hidden by the author)
// ------------------------------------------------------------------
//
		       cmd_cal, 2, 0);
SHELL_CMD_REGISTER(clearcal, NULL, "Clear calibration table", cmd_clearcal);
```

## src/rpr0720.c
```c
#include "rpr0720.h"

//
// ------------------------------------------------------------------
//  Request Full Access to Author: Faizan Saleem Siddiqui
//  Email: faizansaleemsdq@yahoo.com
//  (355 lines of this file are hidden by the author)
// ------------------------------------------------------------------
//
#endif
}
```

## src/rpr0720.h
```c
#pragma once

//
// ------------------------------------------------------------------
//  Request Full Access to Author: Faizan Saleem Siddiqui
//  Email: faizansaleemsdq@yahoo.com
//  (126 lines of this file are hidden by the author)
// ------------------------------------------------------------------
//
/* INT pin: returns 1 = active (low), 0 = inactive, -1 = not configured */
int rpr0720_int_pin_active(void);
```

## src/status_led.c
```c
#include "status_led.h"

//
// ------------------------------------------------------------------
//  Request Full Access to Author: Faizan Saleem Siddiqui
//  Email: faizansaleemsdq@yahoo.com
//  (60 lines of this file are hidden by the author)
// ------------------------------------------------------------------
//
	for_each_led(colors, -1);
}
```

## src/status_led.h
```c
#pragma once

//
// ------------------------------------------------------------------
//  Request Full Access to Author: Faizan Saleem Siddiqui
//  Email: faizansaleemsdq@yahoo.com
//  (16 lines of this file are hidden by the author)
// ------------------------------------------------------------------
//
void status_led_off(uint8_t colors);
void status_led_toggle(uint8_t colors);
```
