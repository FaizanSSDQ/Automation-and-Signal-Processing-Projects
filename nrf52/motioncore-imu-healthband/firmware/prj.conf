## CMakeLists.txt
```
# SPDX-License-Identifier: Apache-2.0

#
# ------------------------------------------------------------------
#  Request Full Access to Author: Faizan Saleem Siddiqui
#  Email: faizansaleemsdq@yahoo.com
#  (4 lines of this file are hidden by the author)
# ------------------------------------------------------------------
#

target_sources(app PRIVATE src/main.c src/bmi270_fifo.c)
```

## sample.yaml
```
sample:
  description: Hello World sample, the simplest Zephyr
#
# ------------------------------------------------------------------
#  Request Full Access to Author: Faizan Saleem Siddiqui
#  Email: faizansaleemsdq@yahoo.com
#  (14 lines of this file are hidden by the author)
# ------------------------------------------------------------------
#
  sample.basic.helloworld:
    tags: introduction
```

## prj.conf
```kconfig
# BMI270 IMU streaming over UART (nRF52840 DK, console on the J-Link VCOM, 115200 8N1)

#
# ------------------------------------------------------------------
#  Request Full Access to Author: Faizan Saleem Siddiqui
#  Email: faizansaleemsdq@yahoo.com
#  (19 lines of this file are hidden by the author)
# ------------------------------------------------------------------
#
CONFIG_LOG=y
CONFIG_LOG_MODE_IMMEDIATE=y
```

## app.overlay
```dts
/*
 * BMI270 IMU breakout on the nRF52840 DK
//
// ------------------------------------------------------------------
//  Request Full Access to Author: Faizan Saleem Siddiqui
//  Email: faizansaleemsdq@yahoo.com
//  (86 lines of this file are hidden by the author)
// ------------------------------------------------------------------
//
	};
};
```

## src/main.c
```c
/*
 * BMI270 IMU streamer for the nRF52840 DK - sensor-driven (FIFO) acquisition
//
// ------------------------------------------------------------------
//  Request Full Access to Author: Faizan Saleem Siddiqui
//  Email: faizansaleemsdq@yahoo.com
//  (562 lines of this file are hidden by the author)
// ------------------------------------------------------------------
//
	return 0;
}
```

## src/bmi270_fifo.c
```c
/*
 * BMI270 FIFO frame parsing - see bmi270_fifo.h
//
// ------------------------------------------------------------------
//  Request Full Access to Author: Faizan Saleem Siddiqui
//  Email: faizansaleemsdq@yahoo.com
//  (85 lines of this file are hidden by the author)
// ------------------------------------------------------------------
//
	}
}
```

## src/bmi270_fifo.h
```c
/*
 * BMI270 FIFO frame parsing (header mode, accelerometer + gyroscope).
//
// ------------------------------------------------------------------
//  Request Full Access to Author: Faizan Saleem Siddiqui
//  Email: faizansaleemsdq@yahoo.com
//  (57 lines of this file are hidden by the author)
// ------------------------------------------------------------------
//

#endif /* BMI270_FIFO_H_ */
```
